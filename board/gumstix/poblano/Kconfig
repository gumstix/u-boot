## board/gumstix/poblano/Kconfig
```kconfig
if TARGET_POBLANO

config SYS_BOARD
	default "poblano"

config SYS_VENDOR
	default "gumstix"

config SYS_SOC
	default "am33xx"

config SYS_CONFIG_NAME
	default "poblano"

endif
```

## configs/pepper_ddr3_defconfig
```kconfig
CONFIG_SPL=y
CONFIG_SYS_EXTRA_OPTIONS="USE_DDR3"
CONFIG_ARM=y
CONFIG_TARGET_PEPPER=y
```
